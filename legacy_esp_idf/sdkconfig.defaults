## legacy_esp_idf/sdkconfig.defaults
```kconfig
#
# Zigbee Configuration
#
CONFIG_ZB_ENABLED=y
# CONFIG_ZB_ZED is not set
CONFIG_ZB_ZCZR=y
CONFIG_ZB_ROUTER=y
# end of Zboss

#
# Partition Table
#
CONFIG_PARTITION_TABLE_CUSTOM=y
CONFIG_PARTITION_TABLE_CUSTOM_FILENAME="partitions.csv"
CONFIG_PARTITION_TABLE_FILENAME="partitions.csv"

# ESP32-H2 Revision Support (for v1.2)
CONFIG_ESP32H2_REV_MIN_102=y
CONFIG_ESP32H2_REV_MIN_FULL=102
CONFIG_ESP32H2_REV_MAX_FULL=199
```
